## conf/distro/poky-bone.conf
```bitbake
require conf/distro/poky.conf

DISTRO = "poky-bone"

#Switch from SysVinit to SystemD
DISTRO_FEATURES_append = " systemd"
VIRTUAL-RUNTIME_init_manager = "systemd"
DISTRO_FEATURES_BACKFILL_CONSIDERED = "sysvinit"

#required for USB Gadget support
MACHINE_EXTRA_RRECOMMENDS = " kernel-modules kernel-devicetree"

#Remove zeroconf feature, as it conflicts with connman
DISTRO_FEATURES_DEFAULT = "alsa argp ext2 largefile usbgadget usbhost wifi xattr nfs"

#At minimum, all images will be able to connect via Ethernet-Over-USB
IMAGE_INSTALL_append = " \
   gadget-init \
   connman \
   connman-client \
"
```

## conf/layer.conf
```bitbake
# We have a conf and classes directory, add to BBPATH
BBPATH .= ":${LAYERDIR}"
# We have recipes-* directories, add to BBFILES
BBFILES += "${LAYERDIR}/recipes-*/*/*.bb \
            ${LAYERDIR}/recipes-*/*/*.bbappend"

BBFILE_COLLECTIONS += "yocto_bone"
BBFILE_PATTERN_yocto_bone = "^${LAYERDIR}/"
BBFILE_PRIORITY_yocto_bone = "7"
LAYERVERSION_yocto_bone = "2"
```
